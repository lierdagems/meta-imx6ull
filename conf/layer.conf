## conf/layer.conf
```bitbake
# We have a conf and classes directory, add to BBPATH
BBPATH .= ":${LAYERDIR}"

# We have recipes-* directories, add to BBFILES
BBFILES += "${LAYERDIR}/recipes-*/*/*.bb \
            ${LAYERDIR}/recipes-*/*/*.bbappend"

BBFILE_COLLECTIONS += "meta-imx6ull"
BBFILE_PATTERN_meta-imx6ull = "^${LAYERDIR}/"
BBFILE_PRIORITY_meta-imx6ull = "6"

LAYERDEPENDS_meta-imx6ull = "core"
LAYERSERIES_COMPAT_meta-imx6ull = "thud"
#LAYERVERSION_meta-imx6ull = 1
```

## conf/machine/imx6ull256.conf
```bitbake
#@TYPE: Machine
#@NAME: IMX6ULL
#@SOC: EVK
#@DESCRIPTION: Machine configuration for IMX6ULL EVK
#@MAINTAINER: hey@lierda.com

DEFAULTTUNE = "cortexa7thf-neon"
include conf/machine/include/tune-cortexa7.inc

# kernel defconfig
KBUILD_DEFCONFIG = "imx6ull-evk-unvs_defconfig"

# device tree
KERNEL_DEVICETREE = "imx6ull-evk-unvs.dtb"

# kernel image type
KERNEL_IMAGETYPE = "zImage"

# TODO: support kernel
PREFERRED_PROVIDER_virtual/kernel = "linux-imx"

# TODO: support u-boot
PREFERRED_PROVIDER_virtual/bootloader = "u-boot-imx"

# u-boot defconfig
UBOOT_MACHINE = "imx6ull-evk-unvs-nand_defconfig"

# USE u-boot.imx
UBOOT_SUFFIX = "imx"

# Default serial consoles (TTYs)
SERIAL_CONSOLES = "115200;ttymxc0"

# Default FSTYPES requested
IMAGE_FSTYPES ?= "tar.xz ext4 ubi"

MACHINE_FEATURES = "usbgadget usbhost vfat ext2"

MKUBIFS_ARGS = "-m 2048 -e 124KiB -c 1925 -F"
UBINIZE_ARGS = "-m 2048 -p 128KiB -s 2048 -O 2048"
```
